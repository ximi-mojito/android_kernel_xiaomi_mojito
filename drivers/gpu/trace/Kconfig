## drivers/gpu/trace/Kconfig
```kconfig
# SPDX-License-Identifier: GPL-2.0-only

config TRACE_GPU_MEM
	bool "Enable GPU memory usage tracepoints"
	default n
	help
	  Choose this option to enable tracepoints for tracking
	  global and per-process GPU memory usage. Intended for
	  performance profiling and required for Android.

	  Tracepoint availability varies by GPU driver.

	  If in doubt, say "N".

config TRACE_GPU_POWER
	bool "Enable GPU power usage tracepoints"
	default n
	help
	  Choose this option to enable tracepoints for tracking
	  global and per-process GPU power usage. Intended for
	  performance profiling and required for Android.

	  Tracepoint availability varies by GPU driver.

	  If in doubt, say "N".
```
